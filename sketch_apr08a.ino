//#include <frequencyToNote.h>
//#include <MIDIUSB_Defs.h>
//#include <MIDIUSB.h>
//#include <pitchToFrequency.h>
//#include <pitchToNote.h>
#include <MIDIUSB.h>
#include <SPI.h>
#include <Wire.h>
#include <Adafruit_GFX.h>
#include <Adafruit_SSD1306.h>
#define OLED_RESET -1 // Reset pin # (or -1 if sharing Arduino reset pin)
#define SCREEN_ADDRESS 0x3C ///< See datasheet for Address; 0x3D for 128x64, 0x3C for 128x32
#define SCREEN_WIDTH 128 // OLED display width, in pixels
#define SCREEN_HEIGHT 64 // OLED display height, in pixels
#define CLK 12
#define DT 8
#define SW 13 
#define btone A1
#define bttwo A3
#define btthree A0
#define btfour A2
#define btfive 11 //bt7  5
#define btsix 9
#define btseven 10//bt8 11 
#define bteight 5//bt5 10
#define CLKT 6 //8
#define DTT 7 //12
#define SWT 4 //13
Adafruit_SSD1306 display(SCREEN_WIDTH, SCREEN_HEIGHT, &Wire, OLED_RESET);
#define IDLE_FRAMES 3
#define ANIM_SIZE 1024
//Midi vars
bool mix_e = false;
int midi_channel = 1;
int midi_fader_base = 33; // or 64
int midi_pan_base = 77;
int midi_fader = 0; //max 7
int midi_pan = 0; //max 7
int midi_bank = 0;
int midi_layer = 0;
int midi_knobpl = 0;
int midi_chan = 1;
bool midi_on = false;
//other vars
int counter;
int hour;
int minute;
bool scrubboi = false;
bool releasedbtone = false;
bool releasedbttwo = false;
bool releasedbtthree = false;
bool releasedbtfour = false;
bool releasedbtfive = false;
bool releasedbtsix = false;
bool releasedbtseven = false;
bool releasedbteight = false;
bool releasedbtnine = false;
bool releasedbtten = false;
bool notidlez = true;
bool idleb = false;
unsigned long lastbutton = 0;
int currentStateCLK;
int lastStateCLK;
int currentDir;
int currentStateCLKT;
int lastStateCLKT;
int currentDirT;
int counterbleh = 0;
unsigned long lastButtonPress = 0;
unsigned long lastButtonPressbtone = 0;
unsigned long lastButtonPressbttwo = 0;
unsigned long lastButtonPressbtthree = 0;
unsigned long lastButtonPressbtfour = 0;
unsigned long lastButtonPressbtfive = 0;
unsigned long lastButtonPressbtsix = 0;
unsigned long lastButtonPressbtseven = 0;
unsigned long lastButtonPressbteight = 0;
unsigned long lastButtonPressbtten = 0;
const unsigned char idleo [] PROGMEM = {
	0x00, 0x00, 0x00, 0x00, 0x00, 0x00, 0x00, 0x00, 0x00, 0x00, 0x00, 0x00, 0x00, 0x00, 0x00, 0x00, 
	0x00, 0x00, 0x00, 0x00, 0x00, 0x00, 0x00, 0x00, 0x00, 0x00, 0x00, 0x00, 0x00, 0x00, 0x00, 0x00, 
	0x00, 0x00, 0x00, 0x00, 0x00, 0x00, 0x00, 0x00, 0x00, 0x00, 0x00, 0x00, 0x00, 0x00, 0x00, 0x00, 
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	0x00, 0x00, 0x00, 0x00, 0x00, 0x00, 0x00, 0x00, 0x00, 0x00, 0x00, 0x00, 0x00, 0x00, 0x00, 0x00
};
const unsigned char idletw [] PROGMEM = {
	0x00, 0x00, 0x00, 0x00, 0x00, 0x00, 0x00, 0x00, 0x00, 0x00, 0x00, 0x00, 0x00, 0x00, 0x00, 0x00, 
	0x00, 0x00, 0x00, 0x00, 0x00, 0x00, 0x00, 0x00, 0x00, 0x00, 0x00, 0x00, 0x00, 0x00, 0x00, 0x00, 
	0x00, 0x00, 0x00, 0x00, 0x00, 0x00, 0x00, 0x00, 0x00, 0x00, 0x00, 0x00, 0x00, 0x00, 0x00, 0x00, 
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	0x00, 0x00, 0x00, 0x00, 0x00, 0x00, 0x00, 0x00, 0x00, 0x00, 0x00, 0x00, 0x00, 0x00, 0x00, 0x00
};
const unsigned char idleth [] PROGMEM = {
	0x00, 0x00, 0x00, 0x00, 0x00, 0x00, 0x00, 0x00, 0x00, 0x00, 0x00, 0x00, 0x00, 0x00, 0x00, 0x00, 
	0x00, 0x00, 0x00, 0x00, 0x00, 0x00, 0x00, 0x00, 0x00, 0x00, 0x00, 0x00, 0x00, 0x00, 0x00, 0x00, 
	0x00, 0x00, 0x00, 0x00, 0x00, 0x00, 0x00, 0x00, 0x00, 0x00, 0x00, 0x00, 0x00, 0x00, 0x00, 0x00, 
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	0x00, 0x00, 0x00, 0x00, 0x00, 0x00, 0x00, 0x00, 0x00, 0x00, 0x00, 0x00, 0x00, 0x00, 0x00, 0x00
};
const unsigned char tapo [] PROGMEM = {
	0x00, 0x00, 0x00, 0x00, 0x00, 0x00, 0x00, 0x00, 0x00, 0x00, 0x00, 0x00, 0x00, 0x00, 0x00, 0x00, 
	0x00, 0x00, 0x00, 0x00, 0x00, 0x00, 0x00, 0x00, 0x00, 0x00, 0x00, 0x00, 0x00, 0x00, 0x00, 0x00, 
	0x00, 0x00, 0x00, 0x00, 0x00, 0x00, 0x00, 0x00, 0x00, 0x00, 0x00, 0x00, 0x00, 0x00, 0x00, 0x00, 
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	0x00, 0x00, 0x00, 0x00, 0x00, 0x00, 0x00, 0x00, 0x00, 0x00, 0x00, 0x00, 0x00, 0x00, 0x00, 0x00
};
const unsigned char tapt [] PROGMEM = {
	0x00, 0x00, 0x00, 0x00, 0x00, 0x00, 0x00, 0x00, 0x00, 0x00, 0x00, 0x00, 0x00, 0x00, 0x00, 0x00, 
	0x00, 0x00, 0x00, 0x00, 0x00, 0x00, 0x00, 0x00, 0x00, 0x00, 0x00, 0x00, 0x00, 0x00, 0x00, 0x00, 
	0x00, 0x00, 0x00, 0x00, 0x00, 0x00, 0x00, 0x00, 0x00, 0x00, 0x00, 0x00, 0x00, 0x00, 0x00, 0x00, 
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	0x00, 0x00, 0x00, 0x00, 0x00, 0x00, 0x00, 0x00, 0x00, 0x00, 0x00, 0x00, 0x00, 0x00, 0x00, 0x00
};
const unsigned char Imgadjust [] PROGMEM = {
	0x00, 0x00, 0x00, 0x00, 0x00, 0x00, 0x08, 0x20, 0xc0, 0x1c, 0x20, 0xc0, 0x3e, 0x20, 0xc0, 0x3e, 
	0x20, 0xc0, 0x00, 0x20, 0x80, 0x00, 0x20, 0xc0, 0x08, 0x23, 0xe0, 0x18, 0x23, 0xe0, 0x18, 0x21, 
	0xc0, 0x18, 0x20, 0x00, 0x18, 0xf8, 0x80, 0x18, 0xf8, 0xc0, 0x18, 0xf8, 0xc0, 0x18, 0x00, 0xc0, 
	0x18, 0x00, 0xc0, 0x18, 0x20, 0xc0, 0x18, 0x20, 0xc0, 0x00, 0x00, 0x00, 0x00, 0x00, 0x00
};
const unsigned char Imgcell [] PROGMEM = {
	0x00, 0x03, 0x00, 0x00, 0x03, 0x00, 0x03, 0xff, 0x00, 0x07, 0xff, 0x00, 0x06, 0x03, 0x00, 0x06, 
	0x03, 0x00, 0x06, 0x03, 0x00, 0x06, 0x03, 0x00, 0x06, 0x03, 0x00, 0x07, 0xff, 0x00, 0x07, 0xff, 
	0x00, 0x07, 0xff, 0x00, 0x07, 0xff, 0x00, 0x07, 0xff, 0x00, 0x07, 0xff, 0x00, 0x07, 0xff, 0x00, 
	0x07, 0xff, 0x00, 0x07, 0xff, 0x00, 0x07, 0xff, 0x00, 0x03, 0xfe, 0x00, 0x00, 0x00, 0x00
};
const unsigned char Imgcopy [] PROGMEM = {
	0x00, 0x00, 0x00, 0x00, 0x00, 0x00, 0x3f, 0xff, 0x00, 0x37, 0xfe, 0x00, 0x20, 0x00, 0x00, 0x33, 
	0xff, 0xc0, 0x37, 0xff, 0xe0, 0x36, 0x00, 0x60, 0x36, 0x00, 0x60, 0x36, 0x00, 0x60, 0x36, 0x00, 
	0x60, 0x36, 0x00, 0x60, 0x36, 0x00, 0x60, 0x36, 0x00, 0x60, 0x36, 0x00, 0x60, 0x26, 0x00, 0x60, 
	0x06, 0x00, 0x20, 0x07, 0xff, 0x60, 0x03, 0xff, 0xe0, 0x00, 0x00, 0x00, 0x00, 0x00, 0x00
};
const unsigned char Imgdesktop [] PROGMEM = {
	0x00, 0x00, 0x00, 0x00, 0x00, 0x00, 0x00, 0x00, 0x00, 0x1f, 0xff, 0xc0, 0x18, 0x00, 0xc0, 0x10, 
	0x00, 0x40, 0x13, 0x00, 0x40, 0x13, 0x00, 0x40, 0x10, 0x00, 0x40, 0x10, 0x00, 0x40, 0x13, 0x00, 
	0x40, 0x10, 0x00, 0x40, 0x10, 0x00, 0x40, 0x1f, 0xff, 0xc0, 0x1f, 0xff, 0xc0, 0x10, 0x00, 0x40, 
	0x18, 0x00, 0xc0, 0x1f, 0xff, 0xc0, 0x00, 0x00, 0x00, 0x00, 0x00, 0x00, 0x00, 0x00, 0x00
};
const unsigned char Imgfolder [] PROGMEM = {
	0x00, 0x00, 0x00, 0x00, 0x00, 0x00, 0x0f, 0xff, 0xc0, 0x0c, 0x03, 0x40, 0x08, 0x03, 0x40, 0x08, 
	0x03, 0x40, 0x08, 0x03, 0x40, 0x08, 0x03, 0x40, 0x08, 0x03, 0x40, 0x08, 0x01, 0xc0, 0x08, 0x00, 
	0x80, 0x08, 0x00, 0x80, 0x08, 0x00, 0x80, 0x08, 0x00, 0x80, 0x08, 0x00, 0x80, 0x08, 0x00, 0x80, 
	0x08, 0x00, 0x80, 0x0c, 0x01, 0x80, 0x0f, 0xff, 0x80, 0x00, 0x00, 0x00, 0x00, 0x00, 0x00
};
const unsigned char Imgdiscord [] PROGMEM = {
	0x00, 0x00, 0x00, 0x00, 0x00, 0x00, 0x00, 0x00, 0x00, 0x03, 0x06, 0x00, 0x08, 0xf8, 0x80, 0x10, 
	0x00, 0x40, 0x20, 0x00, 0x20, 0x20, 0x00, 0x20, 0x40, 0x04, 0x00, 0x41, 0x8e, 0x10, 0x43, 0x8e, 
	0x10, 0x41, 0x8c, 0x10, 0x40, 0x00, 0x10, 0x40, 0x00, 0x10, 0x42, 0x02, 0x10, 0x33, 0xfe, 0x60, 
	0x0e, 0x03, 0x80, 0x00, 0x00, 0x00, 0x00, 0x00, 0x00, 0x00, 0x00, 0x00, 0x00, 0x00, 0x00
};
const unsigned char Imgkill [] PROGMEM = {
	0x00, 0x00, 0x00, 0x00, 0x00, 0x00, 0x00, 0x01, 0x80, 0x00, 0x03, 0x80, 0x00, 0x07, 0x80, 0x00, 
	0x0f, 0x80, 0x00, 0x1d, 0x80, 0x00, 0x39, 0x80, 0x00, 0x63, 0x00, 0x00, 0xc3, 0x00, 0x01, 0xc6, 
	0x00, 0x03, 0xc6, 0xc0, 0x0e, 0x7c, 0xc0, 0x1c, 0x78, 0xc0, 0x38, 0x70, 0xc0, 0x30, 0xc0, 0x00, 
	0x19, 0x80, 0x00, 0x0f, 0x06, 0x00, 0x06, 0x00, 0x00, 0x00, 0x00, 0x00, 0x00, 0x00, 0x00
};
const unsigned char Imgknob [] PROGMEM = {
	0x00, 0x00, 0x00, 0x00, 0x00, 0x00, 0x00, 0x20, 0x00, 0x04, 0x01, 0x00, 0x00, 0x70, 0x00, 0x03, 
	0xfe, 0x00, 0x06, 0xdb, 0x00, 0x2c, 0x51, 0xa0, 0x08, 0x70, 0x80, 0x18, 0x20, 0xc0, 0x10, 0x00, 
	0x40, 0xd0, 0x00, 0x58, 0x10, 0x00, 0x40, 0x10, 0x00, 0x40, 0x18, 0x00, 0xc0, 0x08, 0x00, 0x80, 
	0x24, 0x01, 0x20, 0x06, 0x03, 0x00, 0x01, 0xfc, 0x00, 0x00, 0x00, 0x00, 0x00, 0x00, 0x00
};
const unsigned char Imgvolume [] PROGMEM = {
	0x00, 0x00, 0x00, 0x00, 0x00, 0x00, 0x00, 0x0c, 0x00, 0x00, 0x1c, 0x00, 0x00, 0x3c, 0x00, 0x00, 
	0x7c, 0x00, 0x00, 0xfc, 0x00, 0x0f, 0xfd, 0x00, 0x1f, 0xfd, 0x80, 0x1f, 0xfc, 0xc0, 0x1f, 0xfc, 
	0xc0, 0x1f, 0xfc, 0xc0, 0x1f, 0xfd, 0x80, 0x0f, 0xfd, 0x00, 0x00, 0xfc, 0x00, 0x00, 0x7c, 0x00, 
	0x00, 0x3c, 0x00, 0x00, 0x1c, 0x00, 0x00, 0x0c, 0x00, 0x00, 0x00, 0x00, 0x00, 0x00, 0x00
};
const unsigned char Imgparchment [] PROGMEM = {
	0x00, 0x00, 0x00, 0x00, 0x00, 0x00, 0x03, 0xff, 0x80, 0x07, 0xff, 0x80, 0x0f, 0xff, 0x70, 0x0f, 
	0xff, 0x70, 0x01, 0xff, 0x70, 0x0f, 0xff, 0x00, 0x0f, 0xfc, 0x00, 0x0f, 0xff, 0x00, 0x0f, 0xff, 
	0x00, 0x0f, 0xfc, 0x00, 0x0f, 0xff, 0x00, 0x0f, 0xff, 0x00, 0x00, 0x07, 0x00, 0x3f, 0xff, 0x00, 
	0x3f, 0xfb, 0x00, 0x1f, 0xfb, 0x00, 0x1f, 0xf8, 0x00, 0x00, 0x00, 0x00, 0x00, 0x00, 0x00
};
const unsigned char Imgtime [] PROGMEM = {
	0x00, 0x00, 0x00, 0x00, 0xf8, 0x00, 0x00, 0xf8, 0x00, 0x00, 0x00, 0xc0, 0x01, 0xfc, 0xe0, 0x07, 
	0xff, 0x00, 0x0f, 0xdf, 0x80, 0x0f, 0xdf, 0x80, 0x1f, 0xdf, 0xc0, 0x1f, 0xdf, 0xc0, 0x1f, 0xdf, 
	0xc0, 0x1f, 0xdf, 0xc0, 0x1f, 0xff, 0xc0, 0x1f, 0xff, 0xc0, 0x1f, 0xff, 0xc0, 0x0f, 0xff, 0x80, 
	0x07, 0xff, 0x00, 0x03, 0xfe, 0x00, 0x01, 0xfc, 0x00, 0x00, 0x00, 0x00, 0x00, 0x00, 0x00
};
const unsigned char Imgscreen [] PROGMEM = {
	0x00, 0x00, 0x00, 0x00, 0x00, 0x00, 0x00, 0x00, 0x00, 0xff, 0xff, 0xf8, 0x80, 0x00, 0x08, 0x80, 
	0x00, 0x08, 0x80, 0x01, 0x88, 0x80, 0x03, 0x08, 0x80, 0x0c, 0x08, 0x80, 0x30, 0x08, 0x80, 0xc0, 
	0x08, 0x87, 0x00, 0x08, 0x8c, 0x00, 0x08, 0x80, 0x00, 0x08, 0x80, 0x00, 0x08, 0xc0, 0x00, 0x18, 
	0x00, 0x00, 0x00, 0x07, 0xff, 0x00, 0x00, 0x00, 0x00, 0x00, 0x00, 0x00, 0x00, 0x00, 0x00
};
const unsigned char Imgxbox [] PROGMEM = {
	0x00, 0x00, 0x00, 0x00, 0x00, 0x00, 0x00, 0x00, 0x00, 0x01, 0xfc, 0x00, 0x07, 0x07, 0x00, 0x0f, 
	0x8f, 0x80, 0x08, 0xf8, 0x80, 0x18, 0x70, 0xc0, 0x10, 0xf8, 0x40, 0x10, 0xdc, 0x40, 0x11, 0x8c, 
	0x40, 0x13, 0x06, 0x40, 0x12, 0x02, 0x40, 0x18, 0x00, 0xc0, 0x0c, 0x01, 0x80, 0x0c, 0x01, 0x80, 
	0x07, 0x07, 0x00, 0x01, 0xfc, 0x00, 0x00, 0x00, 0x00, 0x00, 0x00, 0x00, 0x00, 0x00, 0x00
};
const unsigned char Imgsearch [] PROGMEM = {
	0x00, 0x00, 0x00, 0x01, 0xe0, 0x00, 0x07, 0xf8, 0x00, 0x0c, 0x1c, 0x00, 0x18, 0x06, 0x00, 0x30, 
	0x06, 0x00, 0x30, 0x03, 0x00, 0x20, 0x03, 0x00, 0x20, 0x03, 0x00, 0x30, 0x03, 0x00, 0x30, 0x03, 
	0x00, 0x30, 0x06, 0x00, 0x18, 0x0e, 0x00, 0x0e, 0x1e, 0x00, 0x07, 0xff, 0x00, 0x00, 0x83, 0x80, 
	0x00, 0x01, 0xc0, 0x00, 0x00, 0xe0, 0x00, 0x00, 0x60, 0x00, 0x00, 0x00, 0x00, 0x00, 0x00
};
const unsigned char Imgchrome [] PROGMEM = {
	0x00, 0x00, 0x00, 0x00, 0x00, 0x00, 0x01, 0xfc, 0x00, 0x07, 0xff, 0x00, 0x0e, 0x03, 0x80, 0x1c, 
	0x01, 0xc0, 0x18, 0x70, 0xc0, 0x3d, 0xff, 0xe0, 0x37, 0x8e, 0x60, 0x33, 0x06, 0x60, 0x33, 0x06, 
	0x60, 0x33, 0x06, 0x60, 0x31, 0x8c, 0x60, 0x31, 0xfc, 0x60, 0x18, 0x78, 0xc0, 0x1c, 0x11, 0xc0, 
	0x0e, 0x03, 0x80, 0x07, 0xff, 0x00, 0x01, 0xfc, 0x00, 0x00, 0x00, 0x00, 0x00, 0x00, 0x00
};
const unsigned char Imgtask [] PROGMEM = {
	0x00, 0x00, 0x00, 0x00, 0x00, 0x00, 0x7f, 0xff, 0xf0, 0x6e, 0xff, 0xb0, 0x60, 0x00, 0x30, 0x63, 
	0x00, 0x30, 0x67, 0x00, 0x30, 0x6f, 0x83, 0x30, 0x7d, 0xff, 0xb0, 0x78, 0xff, 0x30, 0x60, 0x60, 
	0x30, 0x60, 0x00, 0x30, 0x60, 0x00, 0x30, 0x60, 0x00, 0x30, 0x7f, 0xff, 0xf0, 0x3f, 0xff, 0xe0, 
	0x00, 0x70, 0x00, 0x00, 0xf8, 0x00, 0x01, 0xfc, 0x00, 0x00, 0x00, 0x00, 0x00, 0x00, 0x00
};

int incomingByte = 0;
int Layer = 1;
int notifier = 0;
void setup()
{
  delay(1000);
  Serial.begin(9600);
  Serial.println("Serial started");
  delay(3000);
  display.begin(SSD1306_SWITCHCAPVCC, SCREEN_ADDRESS);
  display.display();
  delay(5000);
  display.clearDisplay();
  display.setTextSize(1);
  display.setTextColor(WHITE);
  display.setCursor(0,0);
  display.println("Loading...");
  display.display();
  delay(5000);
  pinMode(CLK, INPUT);
  pinMode(DT, INPUT);
  pinMode(SW, INPUT_PULLUP);
  pinMode(CLKT, INPUT);
  pinMode(DTT, INPUT);
  pinMode(SWT, INPUT_PULLUP);
  pinMode(btone, INPUT);
  pinMode(bttwo, INPUT);
  pinMode(btthree, INPUT);
  pinMode(btfour, INPUT);
  pinMode(btfive, INPUT);
  pinMode(btsix, INPUT);
  pinMode(btseven, INPUT);
  pinMode(bteight, INPUT);
  lastStateCLK = digitalRead(CLK);
  lastStateCLKT = digitalRead(CLKT);
}
void loop() {
  counterbleh++;
  if (counterbleh > 10000) {
    counterbleh = 0;
  }
  if (Layer < 23) {
    if (millis() - lastButtonPress > 10000) {
      idleb = true;
      notidlez = false;
    }
  }
  
  if (idleb) {
  if (counterbleh == 500) {
    if (Layer > 23) {
      idleb = false;
      notidle();
    }
    else {
    display.clearDisplay();
    display.drawBitmap(0, 0, idleo, 128, 64, 1);
    display.display();
    }
  }
  }
  if (notidlez == false){
    if (!idleb) {
      notidle();
      notidlez = true;
    }
  }
  //noteOn(48, 110, midi_chan);
  midiEventPacket_t rx;
  do {
    rx = MidiUSB.read();
    //Serial.println(rx.byte1, HEX);
    if (rx.header != 0) {
      Serial.print("Received: ");
      Serial.print(rx.header, HEX); //cc
      Serial.print("-");
      Serial.print(rx.byte1, HEX); //channel
      Serial.print("-");
      Serial.print(rx.byte2, HEX); //command
      Serial.print("-");
      Serial.println(rx.byte3, HEX); //value
      
      //notification
      if (rx.header == 0x09){
          midiEventPacket_t eventt = {rx.header, rx.byte1, rx.byte2, 0x7f};
          MidiUSB.sendMIDI(eventt);
          MidiUSB.flush();
          if (Layer != 30) {
            if (Layer != 31)
            {
              Layer = 30;
            }
          }
      }
      if (rx.header == 0x04){
          midiEventPacket_t eventt = {rx.header, rx.byte1, rx.byte2, rx.byte3};
          MidiUSB.sendMIDI(eventt);
          MidiUSB.flush();
          if (Layer != 30) {
            if (Layer != 31)
            {
              Layer = 30;
            }
          }
      }
      if (rx.header == 0x05){
          midiEventPacket_t eventt = {rx.header, rx.byte1, rx.byte2, rx.byte3};
          MidiUSB.sendMIDI(eventt);
          MidiUSB.flush();
          if (Layer != 30) {
            if (Layer != 31)
            {
              Layer = 30;
            }
          }
      }
      if (rx.header == 0x0b){
      if (rx.byte2 == 0x74){
        if (rx.byte3 >= 1){
        notifier = rx.byte3;
        }
        else{
          notifier = 0;
        }
      }
      //layer
      if (rx.byte2 == 0x75){
        Layer = rx.byte3;
        if (rx.byte3 < 12){
          Layer = rx.byte3;
          scrubboi = false;
        }
        else if (rx.byte3 < 22){
          //if Games
          Layer = rx.byte3;
          scrubboi = false;
        }
        else if (rx.byte3 < 32){
          
          //if protools
          Layer = rx.byte3;
          
        }
      }
      }
    if (!idleb){
      if (Layer < 25) {
      notidle();
      }
    }
      //
    }
  } while (rx.header != 0);
  if (idleb) {
  if (counterbleh == 2000) {
    display.clearDisplay();
    display.drawBitmap(0, 0, idletw, 128, 64, 1);
    display.display();
  }
  }

  int btnState = digitalRead(SW);
  currentStateCLK = digitalRead(CLK);
  if (currentStateCLK != lastStateCLK  && currentStateCLK == 1) {
    if (digitalRead(DT) != currentStateCLK) {
      if (Layer < 25) {
      controlChange(112, 100, midi_chan); //clockwise
      }
      else{
      if (scrubboi == false){
        scrubboi = true;
        protools(0x0f, 0x0d);//zone 0d
        protools(0x2f, 0x45);//scrub on
      }
      if (releasedbtnine == true) {
        protools(0x0d, 0x02);
      }
      else {
        protools(0x0d, 0x02);
      }
      }
    } else {
      if (Layer < 25) {
      controlChange(113, 100, midi_chan); //counterclockwise
      }
      else{
       if (scrubboi == false){
        scrubboi = true;
        protools(0x0f, 0x0d);//zone 0d
        protools(0x2f, 0x45);//scrub on
      }
       if (releasedbtnine == true) {
        protools(0x0d, 0x42);
       }
       else {
        protools(0x0d, 0x42); //protools(0x3c, 0x42);
       }
      }
    }
  }
  lastStateCLK = currentStateCLK;

  // button 9
  if (btnState == LOW) {
    if (millis() - lastButtonPress > 50) {
      if (Layer < 23){
        controlChange(110, 100, midi_chan);
      }
      releasedbtnine = true;
    }
    lastButtonPress = millis();
  }
  if (btnState == HIGH) {
    if (releasedbtnine == true) {
      if (Layer < 23){
      controlChange(110, 1, midi_chan);
      }
      releasedbtnine = false;
    }
  }
  if (idleb) {
  if (counterbleh == 4000) {
    display.clearDisplay();
    display.drawBitmap(0, 0, idleth, 128, 64, 1);
    display.display();
  }
  }
  currentStateCLKT = digitalRead(CLKT);

  if (currentStateCLKT != lastStateCLKT  && currentStateCLKT == 1) {
    if (Layer > 22) {
      
      if (Layer == 30) {
      if (digitalRead(DTT) != currentStateCLKT) { //clockwise vs cclockwise

        if (releasedbtten == true) {
          protools((0x40 + midi_fader), 0x01);
        }
        else {
          protools((0x40 + midi_fader), 0x03);
        }
      } 
      else {//counterclockwise
        if (releasedbtten == true) {
          protools((0x40 + midi_fader), 0x41);
        }
        else {
          protools((0x40 + midi_fader), 0x43);
        }
      }
      
      }
      else if (Layer == 31) {//pan
        if (digitalRead(DTT) != currentStateCLKT) { //clockwise vs cclockwise
        if (releasedbtten == true) {
          protools((0x40 + midi_fader), 0x01);
        }
        else {
          protools((0x40 + midi_fader), 0x03);

        }
      } 
        else {//counterclockwise
        if (releasedbtten == true) {
          protools((0x40 + midi_fader), 0x41);
        }
        else {
          protools((0x40 + midi_fader), 0x43);
        }
      }
      
      }
      
    }
    else{
        if (digitalRead(DTT) != currentStateCLKT) {
          controlChange(114, 100, midi_chan); //clockwise if needed use 1 to reset from 100
        } 
        else{
          controlChange(115, 100, midi_chan); //counterclockwise
        }

      }
  }
  lastStateCLKT = currentStateCLKT;

  // Button 10
  int btnStateT = digitalRead(SWT);
  if (btnStateT == LOW) {
    if (millis() - lastButtonPressbtten > 50) {
      if (Layer < 23){
      controlChange(111, 100, midi_chan);
      }
      releasedbtten = true;
    }
    lastButtonPressbtten = millis();
  }
  if (btnStateT == HIGH) {
    if (releasedbtten == true) {
      if (Layer < 23){
      controlChange(111, 1, midi_chan);
      }
      releasedbtten = false;
    }
  }
  if (idleb) {
  if (counterbleh == 6000) {
    display.clearDisplay();
    display.drawBitmap(0, 0, tapo, 128, 64, 1);
    display.display();
  }
  }

  //Button one
  int btnStateone = digitalRead(btone);
  if (btnStateone == HIGH) {
    if (millis() - lastButtonPressbtone > 100) {
      releasedbtone = true;
      if (Layer < 23){
        controlChange(102, 100, midi_chan);
      }
      else{
      if (Layer == 30) {
        protools(0x0f, 0x17); //select zone
        protools(0x2f, 0x00); //loop
        Layer = 31;
        notidle();
      }
      else {
        protools(0x0f, 0x17); //select zone
        protools(0x2f, 0x40); //loop
        Layer = 30;
        notidle();
      }
        while (digitalRead(btone) == HIGH){
          delay(100);
          counter++;
          if (counter > 10){
            protools(0x0f, 0x0a); //select bank and fader change
            for (int i = 0; i <= midi_bank; i++)
            {
              protools(0x2f, 0x41); //bank select
              /* code */
            }
            //Serial.println("Bank reset");
            midi_bank = 0;
            midi_fader = 0;
            midi_pan = 0;
            midi_knobpl = 0;
            Layer = 30;
            counter = 0;
            protools(0x0f, midi_fader);
            protools(0x2f, 0x41);

            break;
          }
          if (digitalRead(btone) == LOW){
            //Serial.println("Bank not reset");
            counter = 0;
            break;
          }
            //controlChange(0, midi_bank, midi_chan);
        }
        counter = 0;
      }
      //}
      //else {
          //Serial.println("btStateone");

      //}
    }
    lastButtonPressbtone = millis();
  }
  if (btnStateone == LOW) {
    if (releasedbtone == true) {
      if (Layer < 23){
      controlChange(102, 1, midi_chan);
      }
      releasedbtone = false;
    }
  }
  
  //Button two
  int btnStatetwo = digitalRead(bttwo);
  if (btnStatetwo == HIGH) {
    if (millis() - lastButtonPressbttwo > 50) {
      if (Layer > 23){
      protools(0x0f, midi_fader); //select fader
      //protools(0x2f, 0x41);

      protools(0x2f, 0x43); //Solo
      }
      if (Layer < 23){
      controlChange(103, 100, midi_chan);
      }
      releasedbttwo = true;
    }
    lastButtonPressbttwo = millis();
  }
  if (btnStatetwo == LOW) {
    if (releasedbttwo == true) {
      if (Layer < 23){
      controlChange(103, 1, midi_chan);
      }
      releasedbttwo = false;
    }
  }
  //button three
  int btnStatethree = digitalRead(btthree);
  if (btnStatethree == HIGH) {
    if (millis() - lastButtonPressbtthree > 50) {
      if (Layer < 23){
        //Serial.print("bt3");
        controlChange(104, 100, midi_chan);

      }
      else{
        protools(0x0f, midi_fader); //select fader
        //protools(0x2f, 0x41);
        protools(0x2f, 0x42); //Mute
      }
      
      
      releasedbtthree = true;
    }
    lastButtonPressbtthree = millis();
  }
  if (btnStatethree == LOW) {
    if (releasedbtthree == true) {
      if (Layer < 23){
      controlChange(104, 1, midi_chan);
      }
      releasedbtthree = false;
    }
  }
  if (idleb) {
  if (counterbleh == 8000) {
    display.clearDisplay();
    display.drawBitmap(0, 0, idleth, 128, 64, 1);
    display.display();
  }
  }

  //Button four
  int btnStatefour = digitalRead(btfour);
  if (btnStatefour == HIGH) {
    if (millis() - lastButtonPressbtfour > 50) {
      //if (Layer > 22) {
        if (mix_e == false){
          protools(0x0f, 0x09);
          protools(0x2f, 0x40);
          //Serial.println("mix_e");
          mix_e = true;
        }
        else {
          mix_e = false;
          protools(0x0f, 0x09);
          protools(0x2f, 0x41);
        }
      //}
      if (Layer < 23){
        controlChange(105, 100, midi_chan);
        }
      releasedbtfour = true;
    }
    lastButtonPressbtfour = millis();
  }
  if (btnStatefour == LOW) {
    if (releasedbtfour == true) {
      if (Layer < 23){
      controlChange(105, 1, midi_chan);
      }
      releasedbtfour = false;
    }
  }
//Button five
  int btnStateeight = digitalRead(bteight);
  if (btnStateeight == HIGH) {
    if (millis() - lastButtonPressbteight > 50) {
      releasedbteight = true;
      if (Layer < 23){  
        controlChange(109, 100, midi_chan);
      }
      else{
      if (Layer == 31){
        //if(midi_knobpl == 0) {
        //flash screen
        //}
        //else {
          midi_knobpl = midi_knobpl - 1;
          protools(0x0f, midi_fader); //select fader
          protools(0x2f, 0x45); //select v
          
        //}
      }
      if (Layer == 30){
        if (midi_fader == 0){
          if (midi_bank == 0){
          // insert flash screen on oled
          }
          else{
            midi_bank = midi_bank - 1;
            midi_fader = 7;
            midi_pan = 7;
            protools(0x0f, 0x0a);//bank zone select
            protools(0x2f, 0x41);
          }
        }
        else{
          midi_fader = midi_fader - 1;
          midi_pan = midi_pan - 1;
          //protools(0x0f, midi_fader); //select fader
          //protools(0x2f, 0x41);
        }
      }
      }
    }
    lastButtonPressbteight = millis();
  }
  if (btnStateeight == LOW) {
    if (releasedbteight == true) {
      if (Layer < 23){
      controlChange(109, 1, midi_chan);
      }
      releasedbteight = false;
    }
  }
  //Button six
  int btnStatesix = digitalRead(btsix);
  if (btnStatesix == HIGH) {
    if (millis() - lastButtonPressbtsix > 50) {
      if (Layer < 23){
      controlChange(107, 100, midi_chan);
      }
      else{
        if (Layer == 31){
          protools(0x0f, midi_fader); //select fader
          protools(0x2f, 0x45);
          //protools(0x0f, 17);
          //protools(0x2f, 0x41);
          midi_knobpl = midi_knobpl + 1;
        }
        else if (Layer == 30){
          if (midi_fader == 7){
            midi_bank = midi_bank + 1;
            midi_fader = 0;
            midi_pan = 0;
            protools(0x0f, 0x0a); //bank select
            protools(0x2f, 0x43);
            //protools(0x0f, midi_fader); //select fader
            //protools(0x2f, 0x41);

          }
          else{
            midi_fader = midi_fader + 1;
            midi_pan = midi_pan + 1;
            //protools(0x0f, midi_fader); //select fader
            //protools(0x2f, 0x41);
      }
        }
      }
      releasedbtsix = true;
    }
    lastButtonPressbtsix = millis();
  }
  if (btnStatesix == LOW) {
    if (releasedbtsix == true) {
      if (Layer < 23){
      controlChange(107, 1, midi_chan);
      }
      releasedbtsix = false;
    }
  }
  //Button seven
  int btnStatefive = digitalRead(btfive);
  if (btnStatefive == HIGH) {
    if (millis() - lastButtonPressbtfive > 50) {
      releasedbtfive = true;
      
      if (Layer < 23){
        controlChange(106, 100, midi_chan);
      }
      else{
        protools(0x0f, midi_fader); //select fade
        protools(0x2f, 0x48); //rec
      }
    }
    lastButtonPressbtfive = millis();
  }
  if (btnStatefive == LOW) {
    if (releasedbtfive == true) {
      if (Layer < 23){
      controlChange(106, 1, midi_chan);
      }
      releasedbtfive = false;
    }
  }
  //button eight
  int btnStateseven = digitalRead(btseven);
  if (btnStateseven == HIGH) {
    if (millis() - lastButtonPressbtseven > 50) {
      releasedbtseven = true;

      if (Layer < 23){
      controlChange(108, 100, midi_chan);
      }
      else{
        protools(0x0f, 0x0f); //select zone
        protools(0x2f, 0x43); //loop
      }
    }
    lastButtonPressbtseven = millis();
  }
  if (btnStateseven == LOW) {
    if (releasedbtseven == true) {
      if (Layer < 23){
       controlChange(108, 1, midi_chan);
      }
      releasedbtseven = false;
    }
  }
  if (idleb) {
  if (counterbleh == 9000) {
    display.clearDisplay();
    display.drawBitmap(0, 0, tapt, 128, 64, 1);
    display.display();
  }
  }

  
MidiUSB.flush();
  
}

void controlChange(byte control, byte value, byte channel) {
  midiEventPacket_t event = {0x0B, 0xB0 | channel, control, value};
  MidiUSB.sendMIDI(event);
  lastButtonPress = millis();
  idleb = false;
}
void protools(byte control, byte value) {
  midiEventPacket_t event = {0x0b, 0xB0, control, value};
  MidiUSB.sendMIDI(event);
  lastButtonPress = millis();
  idleb = false;
}
void noteOn(byte pitch, byte velocity, byte channel) {
  midiEventPacket_t noteOn = {0x09, 0x90 | channel, pitch, velocity};
  MidiUSB.sendMIDI(noteOn);
}

void noteOff(byte pitch, byte velocity, byte channel) {
  midiEventPacket_t noteOff = {0x08, 0x80 | channel, pitch, velocity};
  MidiUSB.sendMIDI(noteOff);
}
void notidle() {
  notidlez = true;
  display.clearDisplay();
  if (Layer == 10){
    display.drawBitmap(5, 0, Imgcopy, 21, 21, 1);
    display.drawBitmap(37, 0, Imgchrome, 21, 21, 1);
    display.drawBitmap(69, 0, Imgfolder, 21, 21, 1);
    display.drawBitmap(101, 0, Imgscreen, 21, 21, 1);
    display.drawBitmap(5, 21, Imgdesktop, 21, 21, 1);
    display.drawBitmap(37, 21, Imgkill, 21, 21, 1);
    display.drawBitmap(69, 21, Imgxbox, 21, 21, 1);
    display.drawBitmap(101, 21, Imgcell, 21, 21, 1);
    display.drawBitmap(5, 42, Imgvolume, 21, 21, 1);
    display.drawBitmap(101, 42, Imgparchment, 21, 21, 1);

  }
  else if (Layer == 11){
    display.drawBitmap(5, 0, Imgcopy, 21, 21, 1);
    display.drawBitmap(37, 0, Imgtask, 21, 21, 1);
    display.drawBitmap(69, 0, Imgfolder, 21, 21, 1);
    display.drawBitmap(101, 0, Imgscreen, 21, 21, 1);
    display.drawBitmap(5, 21, Imgdesktop, 21, 21, 1);
    display.drawBitmap(37, 21, Imgkill, 21, 21, 1);
    display.drawBitmap(69, 21, Imgxbox, 21, 21, 1);
    display.drawBitmap(101, 21, Imgcell, 21, 21, 1);
    display.drawBitmap(5, 42, Imgsearch, 21, 21, 1);
    display.drawBitmap(101, 42, Imgparchment, 21, 21, 1);

  }
  else if (Layer == 20){
    display.drawBitmap(5, 0, Imgcopy, 21, 21, 1);
    display.drawBitmap(37, 0, Imgdiscord, 21, 21, 1);
    display.drawBitmap(69, 0, Imgfolder, 21, 21, 1);
    display.drawBitmap(101, 0, Imgscreen, 21, 21, 1);
    display.drawBitmap(5, 21, Imgdesktop, 21, 21, 1);
    display.drawBitmap(37, 21, Imgkill, 21, 21, 1);
    display.drawBitmap(69, 21, Imgxbox, 21, 21, 1);
    display.drawBitmap(101, 21, Imgcell, 21, 21, 1);
    display.drawBitmap(5, 42, Imgvolume, 21, 21, 1);
    display.drawBitmap(101, 42, Imgparchment, 21, 21, 1);
  }
  else if (Layer == 21){
    display.drawBitmap(5, 0, Imgcopy, 21, 21, 1);
    display.drawBitmap(37, 0, Imgdiscord, 21, 21, 1);
    display.drawBitmap(69, 0, Imgfolder, 21, 21, 1);
    display.drawBitmap(101, 0, Imgscreen, 21, 21, 1);
    display.drawBitmap(5, 21, Imgdesktop, 21, 21, 1);
    display.drawBitmap(37, 21, Imgkill, 21, 21, 1);
    display.drawBitmap(69, 21, Imgxbox, 21, 21, 1);
    display.drawBitmap(101, 21, Imgcell, 21, 21, 1);
    display.drawBitmap(5, 42, Imgvolume, 21, 21, 1);
    display.drawBitmap(101, 42, Imgparchment, 21, 21, 1);
  }
  else if (Layer == 30){
    display.drawBitmap(5, 0, Imgcopy, 21, 21, 1);
    display.setTextSize(2); //changed from 2
    display.setCursor(42,0);
    display.print("S");
    display.setCursor(74,0);
    display.print("M");
    display.drawBitmap(101, 0, Imgadjust, 21, 21, 1);
    display.setCursor(5,21);
    display.print("<-");
    display.setCursor(37,21);
    display.print("->");
    display.setCursor(69,21);
    display.print("R");
    display.setCursor(101,21);
    display.print("LP");
    display.drawBitmap(5, 42, Imgknob, 21, 21, 1);
    display.drawBitmap(101, 42, Imgtime, 21, 21, 1);

  }
  else if (Layer == 31){
    display.drawBitmap(5, 0, Imgcopy, 21, 21, 1);
    display.setTextSize(2);
    display.setCursor(42,0);
    display.print("S");
    display.setCursor(74,0);
    display.print("M");
    display.drawBitmap(101, 0, Imgadjust, 21, 21, 1);
    display.setCursor(5,21);
    display.print("<-");
    display.setCursor(37,21);
    display.print("->");
    display.setCursor(69,21);
    display.print("R");
    display.setCursor(101,21);
    display.print("LP");
    display.drawBitmap(5, 42, Imgknob, 21, 21, 1);
    display.drawBitmap(101, 42, Imgtime, 21, 21, 1);
  }
  display.display();
  //delay(1000);
}
